## br2-external/Config.in
```kconfig
menu "AI Native OS"

source "$BR2_EXTERNAL_AIOS_PATH/package/ai-os-init/Config.in"
source "$BR2_EXTERNAL_AIOS_PATH/package/aios/Config.in"
source "$BR2_EXTERNAL_AIOS_PATH/package/aios-auditd/Config.in"
source "$BR2_EXTERNAL_AIOS_PATH/package/aios-llama/Config.in"
source "$BR2_EXTERNAL_AIOS_PATH/package/aios-modeld/Config.in"

endmenu
```

## br2-external/configs/aios_qemu_aarch64_defconfig
```kconfig
BR2_aarch64=y
BR2_TOOLCHAIN_EXTERNAL=y
BR2_TOOLCHAIN_EXTERNAL_ARM_AARCH64=y
BR2_GLOBAL_PATCH_DIR="$(BR2_EXTERNAL_AIOS_PATH)/board/qemu-aarch64/patches"
BR2_DOWNLOAD_FORCE_CHECK_HASHES=y
BR2_SYSTEM_BIN_SH_BUSYBOX=y
BR2_TARGET_GENERIC_HOSTNAME="ai-native-os"
BR2_TARGET_GENERIC_ISSUE="Welcome to AI Native OS"
BR2_INIT_NONE=y
# BR2_TARGET_GENERIC_GETTY is not set
BR2_ROOTFS_POST_BUILD_SCRIPT="$(BR2_EXTERNAL_AIOS_PATH)/board/qemu-aarch64/post-build.sh"
BR2_LINUX_KERNEL=y
BR2_LINUX_KERNEL_CUSTOM_VERSION=y
BR2_LINUX_KERNEL_CUSTOM_VERSION_VALUE="6.18.7"
BR2_LINUX_KERNEL_USE_CUSTOM_CONFIG=y
BR2_LINUX_KERNEL_CUSTOM_CONFIG_FILE="$(BR2_EXTERNAL_AIOS_PATH)/board/qemu-aarch64/linux.config"
BR2_LINUX_KERNEL_IMAGE=y
BR2_PACKAGE_BUSYBOX_CONFIG_FRAGMENT_FILES="$(BR2_EXTERNAL_AIOS_PATH)/board/qemu-aarch64/busybox.fragment"
BR2_PACKAGE_AI_OS_INIT=y
BR2_PACKAGE_AIOS=y
BR2_PACKAGE_AIOS_AUDITD=y
BR2_PACKAGE_AIOS_LLAMA=y
BR2_PACKAGE_AIOS_MODELD=y
BR2_TARGET_ROOTFS_EXT2=y
BR2_TARGET_ROOTFS_EXT2_4=y
BR2_TARGET_ROOTFS_EXT2_SIZE="160M"
BR2_TARGET_ROOTFS_EXT2_LABEL="ai-native-os"
# BR2_TARGET_ROOTFS_TAR is not set
```

## br2-external/package/ai-os-init/Config.in
```kconfig
config BR2_PACKAGE_AI_OS_INIT
	bool "ai-os-init"
	help
	  Phase-1 init for AI Native OS. Installed as /sbin/ai-os-init
	  and /sbin/init. Mounts early filesystems and starts a shell.

	  Source: services/ai-os-init/ai-os-init
```

## br2-external/package/aios-auditd/Config.in
```kconfig
config BR2_PACKAGE_AIOS_AUDITD
	bool "aios-auditd"
	help
	  Permission and audit daemon. Listens on a Unix socket, appends a
	  hash-chained JSON log, and applies /etc/aios/policy.conf.

	  Source: services/aios-auditd/
```

## br2-external/package/aios-llama/Config.in
```kconfig
config BR2_PACKAGE_AIOS_LLAMA
	bool "aios-llama"
	depends on BR2_INSTALL_LIBSTDCPP
	depends on BR2_TOOLCHAIN_GCC_AT_LEAST_11
	help
	  CPU-only llama.cpp for AI Native OS. Installs llama-cli and
	  llama-server. Weights are not included.

comment "aios-llama needs a toolchain w/ C++, gcc >= 11"
	depends on !BR2_INSTALL_LIBSTDCPP || !BR2_TOOLCHAIN_GCC_AT_LEAST_11
```

## br2-external/package/aios-modeld/Config.in
```kconfig
config BR2_PACKAGE_AIOS_MODELD
	bool "aios-modeld"
	help
	  Local model scheduler. Starts llama-server and exposes a Unix
	  socket. Every local prompt is logged as model.local.

	  Source: services/aios-modeld/aios-modeld.c
```

## br2-external/package/aios/Config.in
```kconfig
config BR2_PACKAGE_AIOS
	bool "aios"
	help
	  Phase-1 status CLI. Installed as /usr/bin/aios, with the
	  welcome banner and /etc/profile.d/aios.sh.

	  Source: shell/aios
```
